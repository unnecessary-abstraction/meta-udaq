## conf/distro/udaq.conf
```bitbake
include conf/distro/include/default-providers.inc
include conf/distro/include/default-versions.inc
include conf/distro/include/default-distrovars.inc
include conf/distro/include/world-broken.inc

TCMODE ?= "default"
require conf/distro/include/tcmode-${TCMODE}.inc

TCLIBC ?= "eglibc"
require conf/distro/include/tclibc-${TCLIBC}.inc

TCLIBCAPPEND = ""

CACHE = "${TMPDIR}/cache/${TCMODE}-${TCLIBC}${@['', '/' + str(d.getVar('MACHINE', True))][bool(d.getVar('MACHINE', True))]}${@['', '/' + str(d.getVar('SDKMACHINE', True))][bool(d.getVar('SDKMACHINE', True))]}"

USER_CLASSES ?= "image-mklibs image-prelink"
PACKAGE_CLASSES ?= "package_ipk"
INHERIT_INSANE ?= "insane"
INHERIT_DISTRO ?= "debian devshell sstate license"
INHERIT += "${PACKAGE_CLASSES} ${USER_CLASSES} ${INHERIT_INSANE} ${INHERIT_DISTRO}"

DISTRO_FEATURES_append = " largefile"

DISTRO = "udaq"
DISTRO_NAME = "UDAQ Platform"
DISTRO_VERSION = "snapshot-${DATE}"
SDK_VENDOR = "-udaqsdk"
SDK_VERSION := "${DISTRO_VERSION}"

MAINTAINER = "Paul Barker <paul@paulbarker.me.uk>"

TARGET_VENDOR = "-udaq"
SDK_NAME = "${DISTRO}-${TCLIBC}-${SDK_ARCH}-${TARGET_ARCH}"
SDKPATH = "/opt/${DISTRO}/${SDK_VERSION}"

ROOT_HOME = "/root"

COPY_LIC_MANIFEST = "1"
COPY_LIC_DIRS = "1"

# We always want a package manager available on the UDAQ
IMAGE_FEATURES += "package-management"
```

## conf/layer.conf
```bitbake
BBPATH .= ":${LAYERDIR}"
BBFILES += "${LAYERDIR}/recipes-*/*/*.bb ${LAYERDIR}/recipes-*/*/*.bbappend"

BBFILE_COLLECTIONS += "udaq-layer"
BBFILE_PATTERN_udaq-layer := "^${LAYERDIR}/"
BBFILE_PRIORITY_udaq-layer = "6"
```
